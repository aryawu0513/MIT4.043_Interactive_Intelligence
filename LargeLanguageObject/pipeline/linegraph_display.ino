#include <Adafruit_GFX.h>
#include <Adafruit_SSD1306.h>
#include <Wire.h>
#include <FastLED.h>
#define LED_PIN 6
#define NUM_LEDS 16
CRGB leds[NUM_LEDS];
float analogValue = 0;
float angle = 0;
int time = 0;
const int BUTTON_PIN = 15;
int lastState = HIGH;
int currentState;
float value = 0;
int x1 = 0, y1 = 0, x2 = 0, y2 = 0;

#define SCREEN_WIDTH 128 // OLED display width, in pixels
#define SCREEN_HEIGHT 32 // OLED display height, in pixels
Adafruit_SSD1306 display(SCREEN_WIDTH, SCREEN_HEIGHT, &Wire, -1);

static const unsigned char PROGMEM musicquestion[] = {
0x00, 0x00, 0x00, 0x00, 0x00, 0x00, 0x00, 0x00, 0x00, 0x00, 0x00, 0x00,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 0x00, 
0x00, 0x00, 0x00, 0x00, 0x00, 0x00, 0xf8, 0x00, 0x1c, 0x07, 0x00, 0x00,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 0x00, 
0x00, 0x00, 0x00, 0x00, 0x00, 0x00, 0x80, 0x00, 0x00, 0x3c, 0x00, 0x00,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 0x00, 
0x00, 0x00, 0x00, 0x00, 0x00, 0xff, 0x80, 0x00, 0x00, 0x00, 0x00, 0x00,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 0x00, 
};

void setup() {
  // Initialize serial communication
  Serial.begin(9600);
  pinMode(A3,INPUT);
  pinMode(BUTTON_PIN, INPUT_PULLUP);

  // Initialize display
   if(!display.begin(SSD1306_SWITCHCAPVCC, 0x3C)) { // Address 0x3D for 128x64
    Serial.println(F("SSD1306 allocation failed"));
    for(;;);
  }
  delay(2000);
  display.clearDisplay();
  FastLED.addLeds<WS2812, LED_PIN, GRB>(leds, NUM_LEDS);
  FastLED.setMaxPowerInVoltsAndMilliamps(5, 500);
  FastLED.clear();
  FastLED.show();

}
void loop() {
  display.clearDisplay();
  if (Serial.available() > 0) {
    String data = Serial.readString();
    // String data = Serial.readStringUntil(';');
    // Serial.print("Received data: ");
    // Serial.println(data);
    analogValue = analogRead(A3);
    angle = map(analogValue, 0, 1023, 0, 315);
    value = int(angle / 315 * 128);
    Serial.print("A:");
    Serial.println(angle);
    display.drawLine(value, 0, value, 32, WHITE);
    
    // Parse data and draw lines
    // int x1 = 0, y1 = 0, x2 = 0, y2 = 0, color; // Initialize to 0 or other appropriate values
    char temp[data.length() + 1];
    strcpy(temp, data.c_str());
    char *ptr1 = strtok(temp, ":");
    // char *ptr1 = strtok(data.c_str(), ":");
    char *ptr2 = strtok(NULL, ":");
    char *ptr = strtok(ptr1, ";");
    while (ptr != NULL) {
      sscanf(ptr, "%d,%d,%d,%d", &x1, &y1, &x2, &y2);
      Serial.print("Drawing line from (");
      Serial.print(x1);
      Serial.print(",");
      Serial.print(y1);
      Serial.print(") to (");
      Serial.print(x2);
      Serial.print(",");
      Serial.print(y2);
      Serial.print(") - ");
      display.drawCircle(x1, y1, 1, WHITE); // Radius of 1 pixel
      display.drawCircle(x2, y2, 1, WHITE); // Radius of 1 pixel
      display.drawLine(x1, y1, x2, y2, WHITE); // Assuming WHITE is the color
      ptr = strtok(NULL, ";");
    }

    display.display();
    // Serial.print("Parsing RGB string: ");
    // Serial.println(ptr2);
    int r, g, b;
    sscanf(ptr2, "%d,%d,%d", &r, &g, &b);
    for (int i=0; i<NUM_LEDS;i++){
      leds[i]=CRGB(r,g,b);
    }
    FastLED.show();
    Serial.print("RGB: ");
    Serial.print(r);
    Serial.print(", ");
    Serial.print(g);
    Serial.print(", ");
    Serial.println(b);
  }
  else if (Serial.available() ==0) {
    display.drawBitmap(0, 0, musicquestion, 128, 32, 1);
    display.display();
  }

}